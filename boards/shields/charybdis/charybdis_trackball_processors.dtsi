/*
 * Copyright (c) 2024 The ZMK Contributors
 * SPDX-License-Identifier: MIT
 * 
 * Common trackball input processor configurations for Charybdis keyboard
 * This file defines the standard processing for snipe, scroll, and move modes
 * 
 * Usage: Include this file and define CHARYBDIS_TRACKBALL_LISTENER macro
 * Example:
 *   #define CHARYBDIS_TRACKBALL_LISTENER snipe { layers = <SNIPING>; input-processors = <&zip_xy_scaler 1 3>; }; scroll { layers = <SCROLL>; input-processors = <&zip_xy_transform (INPUT_TRANSFORM_Y_INVERT)>, <&zip_xy_scaler 1 20>, <&zip_xy_to_scroll_mapper>; }; move { layers = <BASE POINTER>; input-processors = <&zip_xy_scaler 7 6>; };
 */

#include "charybdis_layers.h"
#include <dt-bindings/zmk/input_transform.h>
#include <input/processors.dtsi>

// Standard trackball processing configuration
// Can be used in both standalone (trackball_listener) and dongle mode (input_split_listener)
// Auto mouse layer: moving the ball turns on the POINTER layer, it switches off after this
// many ms without ball movement (QMK's Charybdis default is 650 ms).
#define AUTO_MOUSE_TIMEOUT_MS 700

// Do not jump into the mouse layer if a key was pressed in the last 250 ms
// (avoids accidental activation when the ball is brushed while typing).
&zip_temp_layer {
    require-prior-idle-ms = <250>;
};

#define CHARYBDIS_TRACKBALL_PROCESSORS \
    snipe { \
        layers = <SNIPING>; \
        input-processors = <&zip_xy_scaler 1 3>; \
    }; \
    \
    scroll { \
        layers = <SCROLL>; \
        input-processors = <&zip_xy_transform (INPUT_TRANSFORM_Y_INVERT)>, <&zip_xy_scaler 1 40>, <&zip_xy_to_scroll_mapper>; \
    }; \
    \
    move { \
        layers = <BASE POINTER>; \
        input-processors = <&zip_xy_scaler 1 1>, <&zip_temp_layer POINTER AUTO_MOUSE_TIMEOUT_MS>; \
    };

