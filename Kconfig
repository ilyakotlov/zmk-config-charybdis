## config/west.yml
```yaml
manifest:
  remotes:
  - name: zmkfirmware
    url-base: https://github.com/zmkfirmware
  # ZMK fork with the HID layer-state report (for the ZMK Layer Monitor macOS app)
  - name: pfilipp
    url-base: https://github.com/pfilipp
  - name: badjeff
    url-base: https://github.com/badjeff
  - name: carrefinho
    url-base: https://github.com/carrefinho
  - name: englmaxi
    url-base: https://github.com/englmaxi
  - name: hitsmaxft
    url-base: https://github.com/hitsmaxft
  projects:
  - name: zmk
    remote: pfilipp
    revision: layer-state-report
    import: app/west.yml
  - name: zmk-pmw3610-driver
    remote: badjeff
    revision: zmk-0.4
  - name: prospector-zmk-module
    remote: carrefinho
    revision: feat/new-status-screens
  - name: zmk-dongle-display
    remote: englmaxi
    revision: main
  - name: zmk-dongle-screen-engine
    remote: hitsmaxft
    revision: v1.1.2
    path: modules/zmk-dongle-screen-engine
  - name: zdse-themes
    remote: hitsmaxft
    revision: v1.0.0
    path: modules/zdse-themes
  self:
    path: config
```
